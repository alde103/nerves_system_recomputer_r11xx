## Config.in
```kconfig
# Add project-specific packages for Buildroot here
#
# If these are non-proprietary, please consider contributing them back to
# Nerves or Buildroot.
#

source "$NERVES_DEFCONFIG_DIR/package/recomputer-r110x/Config.in"
source "$NERVES_DEFCONFIG_DIR/package/ch34x/Config.in"
source "$NERVES_DEFCONFIG_DIR/package/rtc-pcf8563w/Config.in"
```

## package/recomputer-r110x/Config.in
```kconfig
menuconfig BR2_PACKAGE_RECOMPUTER_R110X
	bool "recomputer-r110x"
	select BR2_PACKAGE_HOST_DTC
	help
	  reComputer-R110x DTS files that may be useful on Nerves systems.
```
